## arch/arm/core/aarch32/cortex_a/Kconfig
```kconfig
# ARM Cortex-A platform configuration options

# Copyright (c) 2018 Marvell
# Copyright (c) 2018 Lexmark International, Inc.
# SPDX-License-Identifier: Apache-2.0

# NOTE: We have the specific core implementations first and outside of the
# if CPU_CORTEX_A block so that SoCs can select which core they are using
# without having to select all the options related to that core.  Everything
# else is captured inside the if CPU_CORTEX_A block so they are not exposed
# if one selects a different ARM Cortex Family (Cortex-R or Cortex-M)

config CPU_CORTEX_A9
	bool
	select CPU_CORTEX_A
	select ARMV7_A
	select ARMV7_A_FP if CPU_HAS_FPU
	select ARMV7_A_MMU if CPU_HAS_ARM_MMU
	help
	  This option signifies the use of a Cortex-A9 CPU

if CPU_CORTEX_A

config ARMV7_A
	bool
	select ATOMIC_OPERATIONS_BUILTIN
	select ISA_ARM
	help
	  This option signifies the use of an ARMv7-A processor
	  implementation.

	  From https://developer.arm.com/products/architecture/cpu-architecture/a-profile:
	  The Armv7-A architecture implements a traditional Arm architecture with 
	  multiple modes, supports a Virtual Memory System Architecture (VMSA) 
	  based on a Memory Management Unit (MMU), and supports the Arm (A32) and 
	  Thumb (T32) instruction sets.

config ARMV7_A_FP
	bool
	depends on ARMV7_A
	help
	  This option signifies the use of an ARMv7-A processor
	  implementation supporting the Floating-Point Extension.

config ARMV7_A_MMU
	bool
	depends on ARMV7_A
	help
	  This option signifies the use of an ARMv7-A processor
	  implementation supporting the ARM Memory Management Unit (MMU).

config ARMV7_EXCEPTION_STACK_SIZE
	int "Undefined Instruction and Abort stack size (in bytes)"
	default 256
	help
	  This option specifies the size of the stack used by the undefined
	  instruction and data abort exception handlers.

config ARMV7_FIQ_STACK_SIZE
	int "FIQ stack size (in bytes)"
	default 256
	help
	  This option specifies the size of the stack used by the FIQ handler.

config ARMV7_SVC_STACK_SIZE
	int "SVC stack size (in bytes)"
	default 512
	help
	  This option specifies the size of the stack used by the SVC handler.

config ARMV7_SYS_STACK_SIZE
	int "SYS stack size (in bytes)"
	default 1024
	help
	  This option specifies the size of the stack used by the system mode.

config RUNTIME_NMI
	default y

config GEN_ISR_TABLES
	default y

config GEN_IRQ_VECTOR_TABLE
	default n

endif # CPU_CORTEX_A
```

## boards/arm/qemu_cortex_a9/Kconfig.board
```kconfig
#
# Kconfig - Cortex-A9 QEMU Emulation
#
# Copyright (c) 2020, Immo Birnbaum
# SPDX-License-Identifier: Apache-2.0
#

config BOARD_QEMU_CORTEX_A9
	bool "Cortex-A9 Emulation (QEMU)"
	depends on SOC_XILINX_ZYNQ7000
	select QEMU_TARGET
```

## boards/arm/qemu_cortex_a9/Kconfig.defconfig
```kconfig
#
# Kconfig - Cortex-A9 QEMU Emulation
#
# Copyright (c) 2020, Immo Birnbaum
# SPDX-License-Identifier: Apache-2.0
#

if BOARD_QEMU_CORTEX_A9

config BUILD_OUTPUT_BIN
	default n

config BOARD
	default "qemu_cortex_a9"

config SYS_CLOCK_HW_CYCLES_PER_SEC
	int
	default 333333333

config SYS_CLOCK_TICKS_PER_SEC
	default 1000
	
config FLASH_SIZE
	default $(dt_int_val,DT_FLASH_SIZE)

config FLASH_BASE_ADDRESS
	default $(dt_hex_val,DT_FLASH_BASE_ADDRESS)

if SERIAL

	config UART_XLNX_PS
	default y

endif # SERIAL

if NETWORKING

	config NET_L2_ETHERNET
	default y

	config ETH_XLNX_GEM
	default y

	config ETH_XLNX_GEM_PORT_0
	default y

	config ETH_XLNX_GEM_PORT_1
	default n

endif # NETWORKING

endif # BOARD_QEMU_CORTEX_A9
```

## boards/arm/qemu_cortex_a9/qemu_cortex_a9_defconfig
```kconfig
#
# Copyright (c) 2020, Immo Birnbaum
# SPDX-License-Identifier: Apache-2.0
#

CONFIG_SOC_XILINX_ZYNQ7000=y
CONFIG_BOARD_QEMU_CORTEX_A9=y

CONFIG_XLNX_PSTTC_TIMER=n
CONFIG_ARM_ARCH_TIMER=y
#CONFIG_QEMU_TICKLESS_WORKAROUND=y

CONFIG_FLOAT=y
CONFIG_FP_SOFTABI=y

CONFIG_SERIAL=y
CONFIG_UART_XLNX_PS=y

CONFIG_CONSOLE=y
CONFIG_UART_CONSOLE=y

CONFIG_ETH_XLNX_GEM_PORT_0_INIT_PHY=n
CONFIG_ETH_XLNX_GEM_PORT_1_INIT_PHY=n

CONFIG_GPIO=n
CONFIG_XIP=n

CONFIG_TEST_RANDOM_GENERATOR=y
```

## boards/arm/zedboard/Kconfig.board
```kconfig
#
# Kconfig - AVNET/Digilent Zedboard
#
# Copyright (c) 2022, Immo Birnbaum
# SPDX-License-Identifier: Apache-2.0
#

config BOARD_ZEDBOARD
    bool "AVNET/Digilent Zedboard"
	depends on SOC_XILINX_XC7Z020
```

## boards/arm/zedboard/Kconfig.defconfig
```kconfig
#
# Kconfig - AVNET/Digilent Zedboard
#
# Copyright (c) 2022, Immo Birnbaum
# SPDX-License-Identifier: Apache-2.0
#

if BOARD_ZEDBOARD

config BUILD_OUTPUT_BIN
	default n

config BOARD
	default "zedboard"

config SYS_CLOCK_HW_CYCLES_PER_SEC
	int
	default 333333333

config SYS_CLOCK_TICKS_PER_SEC
	default 1000

if CONSOLE

	config UART_CONSOLE
	default y

endif # CONSOLE

if LOG

	if LOG_PROCESS_THREAD

		config LOG_PROCESS_THREAD_STACK_SIZE
		default 8192

	endif # LOG_PROCESS_THREAD

endif # LOG

if NETWORKING

	config NET_L2_ETHERNET
	default y

	config NET_TX_STACK_SIZE
	default 8192

	config NET_RX_STACK_SIZE
	default 8192

	if NET_TCP

		config NET_TCP_WORKQ_STACK_SIZE
		default 8192

	endif # NET_TCP

	if NET_MGMT_EVENT

		config NET_MGMT_EVENT_STACK_SIZE
		default 8192

	endif # NET_MGMT_EVENT

	config TEST_RANDOM_GENERATOR
	default y

endif # NETWORKING

if SERIAL

	config UART_XLNX_PS
	default y

endif # SERIAL

if SHELL

	config SHELL_STACK_SIZE
	default 8192

endif # SHELL

endif # BOARD_ZEDBOARD
```

## boards/arm/zedboard/zedboard_defconfig
```kconfig
#
# Copyright (c) 2022, Immo Birnbaum
# SPDX-License-Identifier: Apache-2.0
#

CONFIG_BOARD_ZEDBOARD=y

CONFIG_SOC_SERIES_XILINX_XC7ZXXX=y
CONFIG_SOC_XILINX_XC7Z020=y

CONFIG_ARM_ARCH_TIMER=y

CONFIG_SERIAL=y
CONFIG_CONSOLE=y
CONFIG_GPIO=y
CONFIG_NETWORKING=y

CONFIG_ARMV7_EXCEPTION_STACK_SIZE=8192
CONFIG_ARMV7_FIQ_STACK_SIZE=8192
CONFIG_ARMV7_SVC_STACK_SIZE=8192
CONFIG_ARMV7_SYS_STACK_SIZE=8192
CONFIG_IDLE_STACK_SIZE=8192
CONFIG_ISR_STACK_SIZE=8192
CONFIG_MAIN_STACK_SIZE=8192
CONFIG_SYSTEM_WORKQUEUE_STACK_SIZE=8192
```
