## drivers/gpio/Kconfig.xlnx_axi
```kconfig
# Xilinx AXI GPIO IP Core driver configuration options
# Copyright (c) 2020 Immo Birnbaum
# SPDX-License-Identifier: Apache-2.0
	
menuconfig GPIO_XLNX_AXI
	bool "Xilinx AXI GPIO driver"
	depends on SOC_XILINX_ZYNQ7000
	select HAS_DTS_GPIO
	help
	  Enable the Xilinx AXI GPIO IP Core driver. Please note that 
	  this driver only supports the first channel of the AXI GPIO 
	  IP core. The optional interrupt functionality of an instance
	  of this driver is enabled by specifying an interrupt line in 
	  its respective device tree entry.
```

## drivers/serial/Kconfig.xlnx
```kconfig
# Xilinx UART configuration

# Copyright (c) 2018 Xilinx Inc.
# SPDX-License-Identifier: Apache-2.0

config UART_XLNX_PS
	bool "Xilinx serial driver for MPSoC / Zynq7000"
	depends on SOC_XILINX_ZYNQMP || SOC_XILINX_ZYNQ7000
	select SERIAL_HAS_DRIVER
	help
	  This option enables the UART driver for Xilinx MPSoC platforms.
```

## dts/bindings/ethernet/phy/ti,dp83867.yaml
```yaml
# Copyright 2024, PHYTEC America, LLC
# SPDX-License-Identifier: Apache-2.0

description: TI DP83867 Ethernet PHY device

compatible: "ti,dp83867"

include: ethernet-phy-common.yaml

properties:
  reset-gpios:
    type: phandle-array
    description: GPIO connected to PHY reset signal pin. Reset is active low.
  int-gpios:
    type: phandle-array
    description: GPIO for interrupt signal indicating PHY state change.
  ti,rx-internal-delay:
    type: int
    description:
      RX internal delay setting for the PHY. Required only if interface
      type is PHY_INTERFACE_MODE_RGMII_ID or PHY_INTERFACE_MODE_RGMII_RXID.
  ti,tx-internal-delay:
    type: int
    description:
      TX internal delay setting for the PHY. Required only if interface type is
      PHY_INTERFACE_MODE_RGMII_ID or PHY_INTERFACE_MODE_RGMII_TXID.
  ti,dp83867-rxctrl-strap-quirk:
    type: boolean
    description:
      This flag indicates that the RX_DV/RX_CTRL pin is strapped in either
      mode 1 or 2 in the current target hardware setup. This can cause the
      PHY to get stuck in internal test mode rather than the regular operation
      mode unless the control bit for the test mode is cleared explicitly
      during the initialization of the PHY.
  ti,interface-type:
    type: string
    description: Which type of phy connection the phy is set up for
    default: "rgmii"
    enum:
      - "rgmii"
      - "rgmii-id"
      - "rgmii-rxid"
      - "rgmii-txid"
  default-speeds:
    default: ["10BASE Half-Duplex", "10BASE Full-Duplex", "100BASE Half-Duplex",
              "100BASE Full-Duplex", "1000BASE Half-Duplex", "1000BASE Full-Duplex"]
```

## dts/bindings/ethernet/xlnx,emacps.yaml
```yaml
# SPDX-License-Identifier: Apache-2.0

description: Xilinx GEM Ethernet controller

compatible: "xlnx,emacps"

include: ethernet.yaml

properties:
    reg:
      required: true
    interrupts:
      required: true
```

## dts/bindings/ethernet/xlnx,gem.yaml
```yaml
#
# Copyright (c) 2020, Immo Birnbaum
# SPDX-License-Identifier: Apache-2.0
#

description: Xilinx GEM Ethernet controller

compatible: "xlnx,gem"

include: ethernet.yaml

properties:
    reg:
      required: true
    interrupts:
      required: true
```

## dts/bindings/gpio/xlnx,axi-gpio.yaml
```yaml
#
# Copyright (c) 2020, Immo Birnbaum
# SPDX-License-Identifier: Apache-2.0
#

description: Xilinx AXI GPIO IP Core driver

compatible: "xlnx,axi-gpio"

include: [gpio-controller.yaml, base.yaml]

properties:
    reg:
      required: true

    label:
      required: true

    interrupts:
      required: false

    "#gpio-cells":
      const: 2

gpio-cells:
  - pin
  - flags
```

## dts/bindings/interrupt-controller/arm,v7a-gic-pl390.yaml
```yaml
# SPDX-License-Identifier: Apache-2.0

description: ARMv7-A GIC PL-390 Interrupt Controller

compatible: "arm,v7a-gic-pl390"

include: base.yaml

properties:
    reg:
      required: true

    label:
      required: true

interrupt-cells:
  - irq
  - priority
  - flags
```

## soc/arm/xilinx_zynq7000/Kconfig.defconfig
```kconfig
#
# Copyright (c) 2019 Lexmark International, Inc.
# Copyright (c) 2020 Immo Birnbaum
# SPDX-License-Identifier: Apache-2.0
#

if SOC_XILINX_ZYNQ7000

config SOC
	default "xilinx_zynq7000"

config NUM_IRQS
	int
	# must be >= the highest interrupt number used
	default 96

config 2ND_LVL_ISR_TBL_OFFSET
	default 1

config MAX_IRQ_PER_AGGREGATOR
	default 95

config NUM_2ND_LEVEL_AGGREGATORS
	default 1

endif
```

## soc/arm/xilinx_zynq7000/Kconfig.soc
```kconfig
# Copyright (c) 2019 Lexmark International, Inc.
#
# SPDX-License-Identifier: Apache-2.0
#

menuconfig SOC_XILINX_ZYNQ7000
	bool "Xilinx Zynq-7000"
	select ARM
	select CPU_CORTEX_A9
	select GIC_PL390
	select MULTI_LEVEL_INTERRUPTS
	select 2ND_LEVEL_INTERRUPTS

config ZYNQ_PS_REF_FREQUENCY
	depends on SOC_XILINX_ZYNQ7000
	int "Processor system reference clock (Hz)"
	default 33333333
	help
	  PS reference clock frequency, to be obtained from the Zynq PS7 summary report.

choice
	prompt "Clock ratio"
	depends on SOC_XILINX_ZYNQ7000
	help
	  Configures the clock ratio.

config ZYNQ_CLOCK_RATIO_6321
        bool "6:3:2:1"
	help
	  Clock ratio is 6:3:2:1, a.k.a. 6:2:1.

config ZYNQ_CLOCK_RATIO_4221
        bool "4:2:2:1"
	help
	  Clock ratio is 4:2:2:1, a.k.a. 4:2:1.

endchoice

config ZYNQ_ARMPLL_MULTIPLIER
	depends on SOC_XILINX_ZYNQ7000
	int "ARM PLL reference frequency multiplier"
	default 40
	help
	  The multiplier applied to the PS reference clock by the ARM PLL.

config ZYNQ_DDRPLL_MULTIPLIER
	depends on SOC_XILINX_ZYNQ7000
	int "DDR PLL reference frequency multiplier"
	default 32
	help
	  The multiplier applied to the PS reference clock by the DDR PLL.

config ZYNQ_IOPLL_MULTIPLIER
	depends on SOC_XILINX_ZYNQ7000
	int "I/O PLL reference frequency multiplier"
	default 30
	help
	  The multiplier applied to the PS reference clock by the I/O PLL.

config ZYNQ_ARMPLL_DIVISOR0
	depends on SOC_XILINX_ZYNQ7000
	int "ARM PLL divisor for cpu_<xxx> generation"
	default 2
	help
	  The divisor applied to the output clock of the ARM PLL based on which the clock signals cpu_6x4x, 
	  cpu_3x2x, cpu_2x and cpu_1x are generated.

config ZYNQ_DDRPLL_DDR3X_DIVISOR0
	depends on SOC_XILINX_ZYNQ7000
	int "DDR PLL divisor for ddr_3x generation"
	default 2
	help
	  The divisor applied to the output clock of the DDR PLL based on which the clock signal ddr_3x 
	  is generated.

config ZYNQ_DDRPLL_DDR2X_DIVISOR0
	depends on SOC_XILINX_ZYNQ7000
	int "DDR PLL divisor for ddr_2x generation"
	default 3
	help
	  The divisor applied to the output clock of the DDR PLL based on which the clock signal ddr_2x 
	  is generated.


config ZYNQ_DDRPLL_DDRDCI_DIVISOR0
	depends on SOC_XILINX_ZYNQ7000
	int "DDR PLL divisor 0 for DDR DCI clock generation"
	default 35
	help
	  The first divisor applied to the output clock of the DDR PLL based on which the DDR DCI clock 
	  signal is generated.

config ZYNQ_DDRPLL_DDRDCI_DIVISOR1
	depends on SOC_XILINX_ZYNQ7000
	int "DDR PLL divisor 1 for DDR DCI clock generation"
	default 3
	help
	  The second divisor applied to the output clock of the DDR PLL based on which the DDR DCI clock 
	  signal is generated.

######################################################################################
# CLOCK CONFIGURATION OF I/O PERIPHERIALS                                            #
######################################################################################

###### ENET0 ######

menu "ENET0 clock configuration"
	depends on SOC_XILINX_ZYNQ7000

choice
	prompt "RX clock, control/data signals source"
	depends on SOC_XILINX_ZYNQ7000
	help
	  Configures the signal source for the RX clock and the control and data signals.

config ZYNQ_ENET0_SRCSEL_MIO
        bool "MIO"
	help
	  Signal source is MIO.

config ZYNQ_ENET0_SRCSEL_EMIO
	bool "EMIO"
	help
	  Signal source is EMIO.

endchoice

choice
	prompt "Controller reference clock source"
	depends on SOC_XILINX_ZYNQ7000
	help
	  Configures the source of the reference clock to be used by GEM0.

config ZYNQ_ENET0_REFCLK_IOPLL
        bool "I/O PLL"
	help
	  Reference clock source is the I/O PLL.

config ZYNQ_ENET0_REFCLK_ARMPLL
        bool "ARM PLL"
	help
	  Reference clock source is the ARM PLL.

config ZYNQ_ENET0_REFCLK_DDRPLL
        bool "DDR PLL"
	help
	  Reference clock source is the DDR PLL.

config ZYNQ_ENET0_REFCLK_EMIOCLK
        bool "EMIO clock"
	help
	  Reference clock source is the EMIO clock.

endchoice

config ZYNQ_ENET0_DIVISOR0
	depends on SOC_XILINX_ZYNQ7000
	int "Reference PLL divisor 0 for ENET0 clock generation - set to 0 for auto-detection"
	default 0
	help
	  The first divisor applied to the output clock of the reference PLL based on which the ENET0 
	  clock signal is generated. If this value is set to 0 and the EMACPS driver is selected for
	  the GEM0 interface, this value will be auto-detected based on the link speed selected in
	  the EMACPS driver's configuration settings. When using the EMACPS driver, manual configuration
	  is only required when using the external EMIO clock.

config ZYNQ_ENET0_DIVISOR1
	depends on SOC_XILINX_ZYNQ7000
	int "Reference PLL divisor 1 for ENET0 clock generation - set to 0 for auto-detection"
	default 0
	help
	  The second divisor applied to the output clock of the reference PLL based on which the ENET0 
	  clock signal is generated. If this value is set to 0 and the EMACPS driver is selected for
	  the GEM0 interface, this value will be auto-detected based on the link speed selected in
	  the EMACPS driver's configuration settings. When using the EMACPS driver, manual configuration
	  is only required when using the external EMIO clock.

endmenu

###### ENET1 ######

menu "ENET1 clock configuration"
	depends on SOC_XILINX_ZYNQ7000

choice
	prompt "RX clock, control/data signals source"
	depends on SOC_XILINX_ZYNQ7000
	help
	  Configures the signal source for the RX clock and the control and data signals.

config ZYNQ_ENET1_SRCSEL_MIO
        bool "MIO"
	help
	  Signal source is MIO.

config ZYNQ_ENET1_SRCSEL_EMIO
	bool "EMIO"
	help
	  Signal source is EMIO.

endchoice

choice
	prompt "Controller reference clock source"
	depends on SOC_XILINX_ZYNQ7000
	help
	  Configures the source of the reference clock to be used by GEM1.

config ZYNQ_ENET1_REFCLK_IOPLL
        bool "I/O PLL"
	help
	  Reference clock source is the I/O PLL.

config ZYNQ_ENET1_REFCLK_ARMPLL
        bool "ARM PLL"
	help
	  Reference clock source is the ARM PLL.

config ZYNQ_ENET1_REFCLK_DDRPLL
        bool "DDR PLL"
	help
	  Reference clock source is the DDR PLL.

config ZYNQ_ENET1_REFCLK_EMIOCLK
        bool "EMIO clock"
	help
	  Reference clock source is the EMIO clock.

endchoice

config ZYNQ_ENET1_DIVISOR0
	depends on SOC_XILINX_ZYNQ7000
	int "Reference PLL divisor 0 for ENET1 clock generation - set to 0 for auto-detection"
	default 0
	help
	  The first divisor applied to the output clock of the reference PLL based on which the ENET1 
	  clock signal is generated. If this value is set to 0 and the EMACPS driver is selected for
	  the GEM1 interface, this value will be auto-detected based on the link speed selected in
	  the EMACPS driver's configuration settings. When using the EMACPS driver, manual configuration
	  is only required when using the external EMIO clock.

config ZYNQ_ENET1_DIVISOR1
	depends on SOC_XILINX_ZYNQ7000
	int "Reference PLL divisor 1 for ENET0 clock generation - set to 0 for auto-detection"
	default 0
	help
	  The second divisor applied to the output clock of the reference PLL based on which the ENET1 
	  clock signal is generated. If this value is set to 0 and the EMACPS driver is selected for
	  the GEM1 interface, this value will be auto-detected based on the link speed selected in
	  the EMACPS driver's configuration settings. When using the EMACPS driver, manual configuration
	  is only required when using the external EMIO clock.

endmenu

###### UART0/1 ######

menu "UART0/1 clock configuration"
	depends on SOC_XILINX_ZYNQ7000

choice
	prompt "Controller reference clock source"
	depends on SOC_XILINX_ZYNQ7000
	help
	  Configures the source of the reference clock to be used by UART0/1.

config ZYNQ_UART01_REFCLK_IOPLL
        bool "I/O PLL"
	help
	  Reference clock source is the I/O PLL.

config ZYNQ_UART01_REFCLK_ARMPLL
        bool "ARM PLL"
	help
	  Reference clock source is the ARM PLL.

config ZYNQ_UART01_REFCLK_DDRPLL
        bool "DDR PLL"
	help
	  Reference clock source is the DDR PLL.

endchoice

config ZYNQ_UART01_DIVISOR0
	depends on SOC_XILINX_ZYNQ7000
	int "Reference PLL divisor for UART0/1 clock generation"
	default 20
	help
	  The divisor applied to the output clock of the reference PLL based on which the UART0/1 clock signal is generated.

endmenu
```
